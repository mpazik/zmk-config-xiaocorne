## boards/shields/corne/Kconfig.defconfig
```kconfig
if SHIELD_CORNE_LEFT

config ZMK_KEYBOARD_NAME
	default "Corne Left"

config ZMK_SPLIT_BLE_ROLE_CENTRAL
	default y

endif

if SHIELD_CORNE_RIGHT

config ZMK_KEYBOARD_NAME
	default "Corne Right"

if SHIELD_CHIPPER_LEFT || SHIELD_CHIPPER_RIGHT

config ZMK_SPLIT
	default y
```

## boards/shields/corny/Kconfig.defconfig
```kconfig
if SHIELD_CORNY_LEFT

config ZMK_KEYBOARD_NAME
	default "Corny Left"

config ZMK_SPLIT_BLE_ROLE_CENTRAL
	default y

endif

if SHIELD_CORNY_RIGHT

config ZMK_KEYBOARD_NAME
	default "Corny Right"

endif


if SHIELD_CORNY_LEFT || SHIELD_CORNY_RIGHT

config ZMK_SPLIT
	default y

endif
```
